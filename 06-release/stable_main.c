/*-------------------------------------------
  L1211 12妲藉厖鐢靛櫒 - 涓荤▼搴?  MCU: SC8F096AD832 QFN32 @ 16MHz
  鍔熻兘: 绯荤粺鍒濆鍖?+ Timer0 ISR(3闃舵鎵弿/杞欢PWM) + 涓诲惊鐜?  鐗堟湰: 2026/06/29 <V2.1> 淇ADC+UART, 鎭㈠瀹屾暣鍏呯數绠＄悊
-------------------------------------------*/
#include "config.h"

/*========================================================================
  鍏ㄥ眬鍙橀噺瀹氫箟 (绗﹀悎config.h extern澹版槑)
========================================================================*/
/* 鎵弿鐘舵€佹満 */
volatile unsigned char g_scanIndex = 0;         /* 褰撳墠鎵弿妲戒綅绱㈠紩(0~11) */
volatile unsigned char g_scanPhase = 0;         /* 褰撳墠鎵弿闃舵: 0=ADC閲囬泦, 1=LED, 2=鎺у埗 */
volatile unsigned int  g_vcc_mv = 5000;         /* 绯荤粺鐢靛帇(mV), VREF鍙嶆帹, Print_SystemStatus鏇存柊 */
volatile bit g_doAdcSample = 0;                 /* ADC閲囨牱璇锋眰鏍囧織: ISR缃?, 涓诲惊鐜鐞?*/
volatile bit g_adcBusy = 0;                     /* ADC蹇欐爣蹇? 涓诲惊鐜噰鏍蜂腑, ISR涓嶉噸澶嶈姹?*/

/* PWM鎺у埗 */
volatile unsigned char g_pwmDuty = 0;           /* PWM鍗犵┖姣?0~PWM_MAX) */
volatile unsigned char g_pwmCounter = 0;        /* PWM璁℃暟鍣?ISR鑷) */
signed int g_cvIntegral = 0;                    /* CV PI绉垎绱姞鍣?*/

/* 绯荤粺璁℃椂 */
volatile unsigned int  g_powerOnTimer = 0;      /* 涓婄數鑷璁℃椂鍣?*/
volatile unsigned char g_powerOnPhase = 0;      /* 涓婄數鑷闃舵: 0鈫?鈫? */

/* NTC娓╁害璇诲彇鐘舵€佹満(ISR涓鏃? 涓诲惊鐜腑鎵цADC) */
volatile unsigned char g_tempPhase = 0;         /* 0=绛夊緟闂撮殧, 1=寤虹珛涓?*/
volatile unsigned int  g_tempSettleCnt = 0;     /* NTC寤虹珛绛夊緟璁℃暟鍣?杞? */
volatile unsigned int  g_tempReadRoundCnt = 0;  /* 娓╁害璇诲彇闂撮殧璁℃暟鍣?杞? */
volatile bit g_doNtcRead = 0;                   /* NTC璇诲彇璇锋眰鏍囧織 */

/* UART鎵撳嵃 */
volatile bit g_printFlag = 0;
volatile unsigned int  g_printTick = 0;

/* DEBUG: 鐘舵€佹満杩借釜 */
volatile unsigned char g_dbgSlot = 0;             /* 鐘舵€佸彉鍖栫殑妲戒綅 */
volatile unsigned char g_dbgOldState = 0;         /* 璺宠浆鍓嶇殑鏃х姸鎬?*/
volatile unsigned char g_dbgNewState = 0;         /* 璺宠浆鍚庣殑鏂扮姸鎬?*/
volatile unsigned char g_dbgNewType = 0;          /* 鏂扮數姹犵被鍨?*/
volatile unsigned int  g_dbgVoltage = 0;          /* 褰撳墠鐢靛帇鍊?*/
volatile bit g_dbgDetectFlag = 0;                 /* 鐘舵€佸彉鍖栨爣蹇? 涓诲惊鐜鐞?*/

/* ADC閫氶亾鏄犲皠琛?ROM) */
const unsigned char s_adcChannels[BATTERY_SLOTS] = {
	ADC_CH_B1AD,   /* B1  = AN17 (RC1) */
	ADC_CH_B2AD,   /* B2  = AN16 (RC0) */
	ADC_CH_B3AD,   /* B3  = AN12 (RB4) */
	ADC_CH_B4AD,   /* B4  = AN13 (RB5) */
	ADC_CH_B5AD,   /* B5  = AN5  (RA5) */
	ADC_CH_B6AD,   /* B6  = AN4  (RA4) */
	ADC_CH_B7AD,   /* B7  = AN28 (楂橀€氶亾) */
	ADC_CH_B8AD,   /* B8  = AN29 (楂橀€氶亾) */
	ADC_CH_B9AD,   /* B9  = AN27 (楂橀€氶亾) */
	ADC_CH_B10AD,  /* B10 = AN26 (楂橀€氶亾) */
	ADC_CH_B11AD,  /* B11 = AN7  (RA7) */
	ADC_CH_B12AD   /* B12 = AN6  (RA6) */
};

/*========================================================================
  鍑芥暟: System_Init
  鍔熻兘: 绯荤粺鍒濆鍖?- 鏃堕挓/GPIO/ANSEL/ADC/UART/Timer0
  寮曡剼鐘舵€? MOSFET鍏ㄩ儴鍏抽棴(Gate=High), ADC杈撳叆楂橀樆, LED鐏?  鍙傝€? 09-test GPIO宸查獙璇侀厤缃?========================================================================*/
void System_Init(void)
{
	unsigned char i;

	/* 1. 鏃堕挓: 16MHz鍐呴儴RC */
	asm("nop");
	asm("clrwdt");
	OSCCON = 0x72;

	/* 2. GPIO鍒濆鍖? MOSFET Gate=High(鍏抽棴AO3401 P娌熼亾)
	   TRIS=1鈫掕緭鍏?妯℃嫙寮曡剼), TRIS=0鈫掕緭鍑?鏁板瓧鎺у埗) */
	TRISA = 0xF0;  PORTA = 0x0F;   /* RA4-7妯℃嫙杈撳叆, RA0-3=High(B1/B2/B5/B6鍏? */
	TRISB = 0x30;  PORTB = 0x4F;   /* RB4-5杈撳叆, RB6(EN)=1, RB7(PWM)=0, RB0-3=High */
	TRISC = 0x07;  PORTC = 0x00;   /* RC0-2妯℃嫙杈撳叆(B2AD/B1AD/NTC), RC3-5杈撳嚭浣?*/
	TRISD = 0xF0;  PORTD = 0x0F;   /* RD4-7妯℃嫙杈撳叆, RD0-3=High(B12/B7/B11/B8鍏? */

	/* 3. 寮变笂鎷?涓嬫媺鍏ㄥ叧 */
	WPUA = 0x00;  WPDA = 0x00;
	WPUB = 0x00;  WPDB = 0x00;
	WPUC = 0x00;
	WPUD = 0x00;

	/* 4. 涓柇杈规部鍏ㄥ叧 */
	IOCA = 0x00;  IOCB = 0x00;

	/* 5. 姣旇緝鍣ㄥ叏鍏?*/
	CC0CON = 0;
	CC1CON = 0;

	/* 6. ANSEL: 妯℃嫙杈撳叆寮曡剼閰嶇疆
	   AN4=RA4, AN5=RA5, AN6=RA6, AN7=RA7 鈫?ANSEL0
	   AN12=RB4, AN13=RB5                鈫?ANSEL1
	   AN16=RC0, AN17=RC1, AN18=RC2(NTC) 鈫?ANSEL2
	   AN26=RD2, AN27=RD3, AN28=RD4, AN29=RD5 鈫?ANSEL3 */
	ANSEL0 = 0xF0;   /* RA4-7: B6AD/B5AD/B12AD/B11AD */
	ANSEL1 = 0x30;   /* RB4-5: B3AD/B8AD */
	ANSEL2 = 0x07;   /* RC0-1: B2AD/B1AD, RC2: NTC(AN18) */
	ANSEL3 = 0x3C;   /* RD2-5: B10AD/B9AD/B7AD/B4AD */

	/* 7. ADC妯″潡鍒濆鍖?(Fosc/32, Tad=2渭s) */
	AD_Init();

	/* 8. 杞欢UART鍒濆鍖?(RC4, 9600bps) */
	uart_init();

	/* 9. Timer0閰嶇疆: 125渭s鍛ㄦ湡
	   Fosc=16MHz, Tcy=0.25渭s, 棰勫垎棰?:2
	   TMR0 reload = 256 - 125渭s/(0.25渭s脳2) = 256 - 250 = 6
	   OPTION_REG: T0LSE_EN=0(姝ｅ父妯″紡), T0CS=0, PSA=0, PS2:0=000(1:2)
	   娉ㄦ剰: SC8F096鐨凮PTION_REG bit7鏄疶0LSE_EN, 涓嶆槸鏍囧噯PIC鐨凴BPU! */
	OPTION_REG = 0x00;      /* T0LSE_EN=0(姝ｅ父), T0CS=0, PSA=0, PS2:0=000(1:2) */
	TMR0 = 6;
	T0IF = 0;
	INTCON = 0xE0;          /* 涓€娆″啓鍏? GIE=1, PEIE=1, T0IE=1, 鍏朵綑娓呴浂 */

	/* 10. 鍒濆鐘舵€? 鎵€鏈夊厖鐢靛叧闂? PWM=0 */
	g_pwmDuty = 0;
	g_pwmCounter = 0;
	PIN_CD1 = 0;
	PIN_CD2 = 0;
	PIN_EN = 1;             /* 涓荤數婧愪娇鑳?Q3 4435) */
	PIN_PWM = 0;

	/* 11. 鍒濆鍖栨Ы浣嶆暟鎹?*/
	for(i = 0; i < 12; i++)
	{
		g_slot[i].state = CHG_IDLE;
		g_slot[i].type = BAT_TYPE_UNKNOWN;
		g_slot[i].voltage = 0;
		g_slot[i].chargeTimer = 0;
		g_ccBlocks[i] = 0;
		g_ovCnt[i] = 0;
	}
	g_blinkTick = 0;

	/* 12. 寮€鍏ㄥ眬涓柇(宸插湪INTCON涓缃? */
}

/*========================================================================
  Timer0 涓柇鏈嶅姟绋嬪簭
  鍛ㄦ湡: ~125渭s (Timer0閲嶈浇鍊?, 棰勫垎棰?:2)
  鍔熻兘:
    1. 杞欢PWM鐢熸垚(RB7, 250Hz, 32绾у垎杈ㄧ巼)
    2. 3闃舵鎵弿鐘舵€佹満: Phase0(璇锋眰ADC) 鈫?Phase1(LED鏇存柊) 鈫?Phase2(鎺у埗)
    3. NTC娓╁害璇诲彇鐘舵€佹満(浠呰鏃? ADC鐢变富寰幆鎵ц)
    4. UART鎵撳嵃瑙﹀彂(姣忕涓€娆?
  璇存槑: ADC閲囬泦鏀惧湪涓诲惊鐜腑鎵ц(鑰楁椂~680渭s), ISR浠呰缃姹傛爣蹇?========================================================================*/
void interrupt Isr_Timer(void)
{
	/* --- Timer0涓柇澶勭悊 --- */
	if(T0IF)
	{
		T0IF = 0;
		TMR0 = 6;                   /* 閲嶈浇125渭s鍛ㄦ湡 */
		asm("clrwdt");              /* 鍠傜嫍 */

		/* === 1. 杞欢PWM鐢熸垚(RB7, 250Hz, 4ms鍛ㄦ湡) === */
		g_pwmCounter++;
		if(g_pwmCounter >= PWM_RESOLUTION)
			g_pwmCounter = 0;

		/* 杈撳嚭PWM娉㈠舰 */
		if(g_pwmDuty > 0 && g_pwmCounter < g_pwmDuty)
			PIN_PWM = 1;
		else
			PIN_PWM = 0;

		/* === 2. 涓婄數鑷搴忓垪(鍓?绉? === */
		if(g_powerOnPhase < 2)
		{
			PowerOnLedSequence();   /* 璇ュ嚱鏁颁粎浠呬綔涓哄欢鏃?绉掔ǔ瀹氱數璺紝娌℃湁鍏朵粬鍔熻兘 */
			return;                 /* 鑷鏈熼棿涓嶆墽琛屾壂鎻?*/
		}

		/* === 3. 3闃舵鎵弿鐘舵€佹満 === */
		switch(g_scanPhase)
		{
		case 0:  /* Phase0: 璇锋眰ADC閲囬泦褰撳墠妲界數鍘?		           鍏抽棴褰撳墠妲組OSFET, 璁炬爣蹇楄涓诲惊鐜墽琛孉DC_Sample */
			if(!g_adcBusy && !g_doAdcSample)
			{
				SLOT_CHARGE_OFF(g_scanIndex);
				g_doAdcSample = 1;      /* 涓诲惊鐜娴嬫鏍囧織鍚庢墽琛孉DC */
			}
			/* 涓嶅垏鎹㈤樁娈? 绛夊緟涓诲惊鐜畬鎴怉DC鍚庡啀鎺ㄨ繘 */
			break;

		case 1:  /* Phase1: LED鐘舵€佹洿鏂?ADC宸插畬鎴? 鐢靛帇宸插瓨鍏lot) */
			Update_LED_Slot(g_scanIndex);
			/* 鏍规嵁鍏呯數鐘舵€佹仮澶峂OSFET(鍦≒hase2鐨凜harging_Control涓粺涓€澶勭悊) */
			g_scanPhase = 2;  		/* 褰撴墽琛屽畬ADC閲囬泦涔嬪悗锛岃烦杞埌杩欎釜闃舵锛屼箣鍚庢帹杩涘埌鎺у埗闃舵 */
			break;

		case 2:  /* Phase2: 绯荤粺绾ф帶鍒?浠呮Ы0鎵ц) */
			if(g_scanIndex == 0)
			{
				/* 瀹炴椂VCC閲囨牱: 姣忔鎵弿鍛ㄦ湡(~80ms)鏇存柊, 渚汭MP_CHECK鍋歂iMH VCC濉岄櫡妫€娴?*/
				if(!g_adcBusy)
				{
					g_adcBusy = 1;
					test_adc = ADC_Sample(ADC_CH_VREF, 0);
					if(ADC_OK == test_adc)
					{
						unsigned long pt = POWER_RATIO / adresult;
						g_vcc_mv = (unsigned int)pt;
					}
					g_adcBusy = 0;
				}

				Charging_Control();     /* 12璺疢OSFET浣胯兘鏇存柊 */
				CCCV_Control();         /* CC-CV PWM鍗犵┖姣旇皟鑺?*/
				Led_BlinkProcess();     /* LED闂儊璁℃椂 */

				/* === NTC娓╁害璇诲彇鐘舵€佹満 === */
			{
				if(g_tempPhase == 0)
				{
					g_tempReadRoundCnt++;
					if(g_tempReadRoundCnt >= TEMP_READ_INTERVAL)
					{
						g_tempReadRoundCnt = 0;
						g_tempPhase = 1;
						g_tempSettleCnt = 0;
					}
				}
				else
				{
					g_tempSettleCnt++;
					if(g_tempSettleCnt >= NTC_SETTLE_ROUNDS)
					{
						g_doNtcRead = 1;
						g_tempSettleCnt = 0;
						g_tempPhase = 0;
					}
				}
			}

			/* === UART鎵撳嵃瑙﹀彂(姣忕涓€娆? === */
			if(++g_printTick >= TICK_PER_SEC)
			{
				g_printTick = 0;
				g_printFlag = 1;
			}
			}

			/* 鎺ㄨ繘鍒颁笅涓€涓Ы浣?*/
			if(++g_scanIndex >= BATTERY_SLOTS)
				g_scanIndex = 0;
			g_scanPhase = 0;
			break;

		default:
			g_scanPhase = 0;
			break;
		}
	}
}

/*========================================================================
  鍑芥暟: Do_AdcSample
  鍔熻兘: 鎵цADC閲囨牱骞跺瓨鍏ユЫ浣嶇數鍘?  璇存槑: 浠庝富寰幆璋冪敤, 鍦↖SR Phase0璁剧疆g_doAdcSample鍚庢墽琛?  浣跨敤VDD鍙傝€?涓?9-test瀹屽叏涓€鑷?
========================================================================*/
void Do_AdcSample(void)
{
	unsigned char ch = s_adcChannels[g_scanIndex];
	unsigned char ty = S_TYPE(g_scanIndex);
	unsigned char st = S_STATE(g_scanIndex);
	unsigned char dly;       /* 寤舵椂寰幆璁℃暟鍣?8浣峂CU __delay_us鍙傛暟婧㈠嚭瑙勯伩) */

	/* 寤舵椂绛夊緟Bx鑺傜偣绋冲畾鍒扮數姹犲紑璺數鍘?	   ISR Phase0宸插叧闂璏OSFET, Bx鑺傜偣浠嶱WM椹卞姩鐢靛帇鎭㈠鍒板紑璺數鍘嬮渶瑕佹椂闂?	   绾挎€ч攤鐢垫睜(鏃燾harger IC鎷夎浇): MOSFET瀵奸€氭椂BxAD鐢靛琚玃WM鍏呯數鑷宠繎VCC,
	   鍏虫柇鍚庣數瀹归€氳繃楂橀樆璺緞鏀剧數, 100渭s杩滀笉澶?瀹炴祴璇诲埌浼狾PEN=4091),
	   寤堕暱鑷?000渭s纭繚鐢靛鏀捐嚦鐢垫睜鐪熷疄鐢靛帇
	   鍏呯數鐘舵€?MOSFET鍒氳鍏抽棴): ACTIVATE/PRECHARGE/CC/CV
	   DETECT鐘舵€? 閰嶅悎Charging_Control涓璂ETECT鏃禡OSFET瀵奸€?
	   鐢靛浠庣數姹犵湡瀹炵數鍘媀bat璧峰厖, 闇€瓒冲寤舵椂浣胯鏁板尮閰嶆棫浣撲簩鏋佺鍧囪　鐢靛钩
	   (~Vbat+0.5V), 鍚﹀垯浣庝簬NIMH_LOW(1015)鐨勭數姹犱細婕忚繃IMP_CHECK鐩存帴杩汱I_ION
	   IMP_CHECK鐘舵€? 鑴夊啿鍚嶤Dx鎬荤嚎鎷変綆, P-ch MOSFET娌熼亾鍏抽棴(V_GS=0),
	   鑻ヤ綋浜屾瀬绠¤绾挎€ч攤鐢垫睜闃绘柇, BxAD鐢靛閫氳繃100K涓婃媺鍏呯數鑷砎CC闇€瓒冲寤舵椂,
	   100渭s浠呭厖鑷?967(娴嬩笉鍒癘PEN), 2000渭s鍙厖鑷斥墺3990瑙﹀彂LINEAR_LI妫€娴?	   娉? SC8F096 8浣嶇紪璇戝櫒__delay_us(2000)鍙兘鎴柇澶辨晥, 鎷嗕负20x100渭s寰幆 */
	if((ty == BAT_TYPE_LINEAR_LI &&
	    (st == CHG_ACTIVATE || st == CHG_PRECHARGE ||
	     st == CHG_CC_CHARGE || st == CHG_CV_CHARGE)) ||
	   st == CHG_DETECT ||
	   st == CHG_IMP_CHECK)
	{
		for(dly = 0; dly < 20; dly++)
			__delay_us(100);
	}
	else
	{
		__delay_us(100);
	}

	test_adc = ADC_Sample(ch, 0);           /* VDD鍙傝€? 涓?9-test涓€鑷?*/

	if(ADC_OK == test_adc)
		g_slot[g_scanIndex].voltage = adresult;
	else
		g_slot[g_scanIndex].voltage = 0;

	g_scanPhase = 1;                        /* 鎺ㄨ繘鍒癓ED鏇存柊闃舵 */
}

/*========================================================================
  鍑芥暟: Do_NtcRead
  鍔熻兘: 鎵цNTC ADC璇诲彇骞舵洿鏂版俯搴?  璇存槑: RC2/AN18涓篘TC涓撶敤妯℃嫙寮曡剼, 鏃犻渶鍒嗘椂澶嶇敤
        涓?9-test涓€鑷? VDD鍙傝€? 鐩存帴ADC_Sample(18, 0)
========================================================================*/
void Do_NtcRead(void)
{
	Read_Temperature();
}

/*========================================================================
  鍑芥暟: Print_NtcTemp
  鍔熻兘: 鎵撳嵃NTC娓╁害(姣忕涓€娆? 鐙珛浜庣郴缁熺姸鎬佹墦鍗?
========================================================================*/
void Print_NtcTemp(void)
{
	uart_send_string("NTC=");
	uart_send_number(g_temperature / 10U);
	uart_send_string(".");
	uart_send_number(g_temperature % 10U);
	uart_send_string("C\r\n");
}

/*========================================================================
  鍑芥暟: Print_SystemStatus
  鍔熻兘: 鎵撳嵃12妲界郴缁熺姸鎬?姣忕涓€娆?
  杈撳嚭: VCC=鐢靛帇 T=娓╁害 B1~B12 ADC鍊?鐢垫睜mV/鐘舵€?  绉绘鑷?9-test: 鍙屽弬鏁扮嚎鎬ф爣瀹氬叕寮忚绠楃數姹爉V
========================================================================*/
/* B2-B12鎵撳嵃寮€鍏? 0=浠匓1璇︾粏, 1=鍏ㄩ儴12妲?*/
#define PRINT_ALL_SLOTS     0
/* B1-B6鎵撳嵃寮€鍏? 1=B1~B6閫愯鎵撳嵃 */
#define PRINT_B1_B6         1

void Print_SystemStatus(void)
{
	unsigned char i;
	unsigned int vcc_mv;

	uart_send_string("\r\n== L1211 12CH CHARGER ==\r\n");

	/* VCC娴嬮噺(鍐呴儴1.2V鍙傝€冨弽鎺? */
	test_adc = ADC_Sample(ADC_CH_VREF, 0);
	if(ADC_OK == test_adc)
	{
		unsigned long pt = POWER_RATIO / adresult;
		vcc_mv = (unsigned int)pt;
	}
	else
		vcc_mv = 5000;

	g_vcc_mv = vcc_mv;

	uart_send_string("VCC=");
	uart_send_number(vcc_mv);
	uart_send_string("mV T=");
	uart_send_number(g_temperature / 10U);
	uart_send_string(".");
	uart_send_number(g_temperature % 10U);
	uart_send_string("C IMP_LOCK=");
	uart_send_number(g_impCheckSlot == 0xFF ? 0xFFU : (unsigned int)g_impCheckSlot);
	uart_send_string("\r\n");

#if PRINT_B1_B6
	/* B1-B6閫愯鎵撳嵃(姣忎釜妲界嫭绔嬩竴琛? 渚夸簬瑙傚療) */
	for(i = 0; i < 6; i++)
#elif PRINT_ALL_SLOTS
	/* 12妲藉叏閮ㄦ墦鍗?*/
	for(i = 0; i < 12; i++)
#else
	/* 浠匓1璇︾粏璋冭瘯 */
	for(i = 0; i < 1; i++)
#endif
	{
		unsigned int v = S_VOLT(i);
		unsigned char s = S_STATE(i);

#if PRINT_ALL_SLOTS && !PRINT_B1_B6
		/* 鎹㈣: 姣?涓Ы涓€琛?*/
		if(i == 6) uart_send_string("\r\n");
#endif

		uart_send_char('B');
		uart_send_number((unsigned int)i + 1U);
		uart_send_char('=');
		uart_send_number(v);

		/* 鐢垫睜mV鏍″噯(涓?9-test涓€鑷?:
		   vx_mv = ADC * VCC / 4096 鈫?BxAD寮曡剼mV
		   bat_mv = (1159 * vx_mv - 647 * VCC) / 1000 */
		{
			unsigned long vx_mv = (unsigned long)v * (unsigned long)vcc_mv / 4096UL;
			if(vx_mv + 200U >= (unsigned long)vcc_mv)
			{
				uart_send_string(" OPEN");
			}
			else
			{
				unsigned long bat_mv_long = ALPHA_NUM * vx_mv;
				if(bat_mv_long > (BETA_NUM * (unsigned long)vcc_mv))
				{
					bat_mv_long = (bat_mv_long - BETA_NUM * (unsigned long)vcc_mv + CAL_DEN/2UL) / CAL_DEN;
					uart_send_string(" BAT(");
					uart_send_number((unsigned int)bat_mv_long);
					uart_send_string("mV)");
				}
				/* else: 鐢靛帇杩囦綆(鏃犵數姹?鐭矾), 涓嶆樉绀簃V */
			}
		}

		/* 鐘舵€佺缉鍐?*/
		uart_send_char(' ');
		switch(s)
		{
		case CHG_IDLE:       uart_send_string("[IDLE]"); break;
		case CHG_DETECT:     uart_send_string("[DET]");  break;
		case CHG_ACTIVATE:   uart_send_string("[ACT]");  break;
		case CHG_PRECHARGE:  uart_send_string("[PRE]");  break;
		case CHG_CC_CHARGE:  uart_send_string("[CC]");   break;
		case CHG_CV_CHARGE:  uart_send_string("[CV]");   break;
		case CHG_FULL:       uart_send_string("[FULL]"); break;
		case CHG_ERROR:
		{
			unsigned char t = S_TYPE(i);
			if(t == BAT_TYPE_NIMH || t == BAT_TYPE_DRY)
				uart_send_string("[Dry/NiMH ERR]");
			else if(t == BAT_TYPE_LI_ION)
				uart_send_string("[Li-ion ERR]");
			else if(t == BAT_TYPE_LINEAR_LI)
				uart_send_string("[Linear Li ERR]");
			else
				uart_send_string("[ERR]");
			break;
		}
		case CHG_IMP_CHECK:  uart_send_string("[IMP]");  break;
		case CHG_IMP_DIODE_TEST: uart_send_string("[DIO]"); break;
		default:             uart_send_string("[???]");  break;
		}

		/* 鎵撳嵃 ct(chargeTimer) 鍜?ty(鐢垫睜绫诲瀷) 鐢ㄤ簬璋冭瘯 */
		uart_send_string(" ct=");
		uart_send_number(S_TIMER(i));
		uart_send_string(" ty=");
		uart_send_number(S_TYPE(i));

#if PRINT_B1_B6
		uart_send_string("\r\n");
#endif
	}
	uart_send_string("\r\n");
}

/*========================================================================
  鍑芥暟: Print_DetectLog
  鍔熻兘: 鎵撳嵃鐢垫睜绫诲瀷妫€娴嬫棩蹇?妫€娴嬪埌鍚勭被鐢垫睜鏃惰皟鐢?
========================================================================*/
void Print_DetectLog(void)
{
	uart_send_char('B');
	uart_send_number((unsigned int)g_detectLogSlot + 1U);

	if(g_detectLogType == BAT_TYPE_NIMH)
		uart_send_string(": NiMH detected! Not charging.\r\n");
	else if(g_detectLogType == BAT_TYPE_DRY)
		uart_send_string(": Dry/NiMH detected! Not charging.\r\n");
	else if(g_detectLogType == BAT_TYPE_LINEAR_LI)
		uart_send_string(": Linear Li detected! Charging.\r\n");
}

/*========================================================================
  涓诲嚱鏁?  娴佺▼:
    1. System_Init() - 鍒濆鍖栨墍鏈夋ā鍧? 鍚姩Timer0 ISR
    2. 涓婄數鑷2绉?ISR涓鐞? 缁跨伅鈫掔孩鐏啋姝ｅ父)
    3. 涓诲惊鐜?
       - ADC閲囨牱(g_doAdcSample鏍囧織)
       - NTC娓╁害璇诲彇(g_doNtcRead鏍囧織)
       - UART鐘舵€佹墦鍗?g_printFlag鏍囧織)
       - 鍠傜嫍
========================================================================*/
void main(void)
{
	/* ICSP鐑у綍淇濇姢寤舵椂 */
	__delay_ms(10);
	asm("clrwdt");

	/* 绯荤粺鍒濆鍖?*/
	System_Init();

	/* 绛夊緟涓婄數鑷瀹屾垚(ISR涓鐞? */
	uart_send_string("L1211 Charger V2.1\r\n");
	uart_send_string("Init...\r\n");

	/* 涓诲惊鐜?*/
	while(1)
	{
		asm("clrwdt");

		/* --- ADC閲囨牱: ISR Phase0璇锋眰, 涓诲惊鐜墽琛?--- */
		if(g_doAdcSample)
		{
			g_doAdcSample = 0;
			g_adcBusy = 1;
			Do_AdcSample();
			ChargeProcess_Slot(g_scanIndex);

			/* --- 妲戒綅0鐘舵€佸彉鍖栬皟璇曡緭鍑?杩借釜姣忔鐘舵€佽烦杞? --- */
			if(g_dbgDetectFlag)
			{
				g_dbgDetectFlag = 0;
			uart_send_string("DBG: slot=");
			uart_send_number(g_dbgSlot);
			uart_send_string(" old=");
			uart_send_number(g_dbgOldState);
			uart_send_string(" new=");
			uart_send_number(g_dbgNewState);
			uart_send_string(" ty=");
			uart_send_number(g_dbgNewType);
			uart_send_string(" V=");
			uart_send_number(g_dbgVoltage);
			uart_send_string("\r\n");
			}

			g_adcBusy = 0;
		}

		/* --- NTC娓╁害璇诲彇: ISR寤虹珛瀹屾垚鍚庤Е鍙?--- */
		if(g_doNtcRead)
		{
			g_doNtcRead = 0;
			g_adcBusy = 1;
			Do_NtcRead();
			g_adcBusy = 0;
		}

		/* --- UART鎵撳嵃: 姣忕瑙﹀彂涓€娆?--- */
		if(g_printFlag)
		{
			g_printFlag = 0;
			Print_SystemStatus();
			Print_NtcTemp();
		}

		/* --- 鐢垫睜妫€娴嬫棩蹇? NiMH/骞茬數姹犺瘑鍒椂鎵撳嵃 --- */
		if(g_detectLogFlag)
		{
			g_detectLogFlag = 0;
			Print_DetectLog();
		}
	}
}

/*========================================================================
  鍚堝苟缂栬瘧: 浠ヤ笅妯″潡閫氳繃#include鏂瑰紡骞跺叆main.c
  SCMCU IDE鍗曟枃浠剁紪璇戞ā寮忎笅, 鎵€鏈?c鏂囦欢闇€鍚堝苟涓轰竴涓炕璇戝崟鍏?========================================================================*/
#include "adc_drv.c"       /* ADC椹卞姩: adresult, test_adc, ADC_Sample, AD_Init */
#include "uart_dbg.c"      /* 杞欢UART: uart_init, uart_send_char/string/number */
#include "charge_mgr.c"    /* 鍏呯數绠＄悊: g_temperature, Read_Temperature, ChargeProcess_Slot, CCCV_Control, Charging_Control */
#include "led.c"           /* LED鎺у埗: Update_LED_Slot, Led_BlinkProcess, PowerOnLedSequence */
