/*-------------------------------------------

程序名称：比较器设置示例程序
日期版本：2024/09/18 <V1.0>

      
*本程序由 &应用支持部& 编写整理
-------------------------------------------*/


#include <sc.h>						//芯片头文件，会根据工程选项自动寻找对应型号头文件


void main(void)
{
	asm("nop");
	asm("clrwdt");
	
	OSCCON = 0x72;					//16MHZ,内部振荡器用作系统时钟,CONFIG关闭WDT时必需软件打开WDT
	OPTION_REG = 0x09;				//配置WDT时间，09为2分频，即16*2=32ms溢出
	
	
	WPUB = 0B00000000;
	WPDB = 0B00000000;
	IOCB = 0B00000000;
	
	TRISA = 0B00000000;	
	TRISB = 0B00000000;
	
	PORTA = 0B00000000;	
	PORTB = 0B00000000;
	
	/***************************************************
	比较器控制寄存器 CMPxCON0
	Bit7  CMPxEN:  CMP使能位
		1=  使能CMP
		0=  禁止CMP
	Bit6  CMPxPS:  CMP正端输入选择位
		1=  CMP+端口电压
		0=  VDD经过内部电阻分压后的电压
	Bit5~Bit3  CMPxNS<2:0>:  CMP负端输入选择位
		000=  CMP0- 端口电压
		001=  CMP1- 端口电压
		010=  CMP2-端口电压
		011=  CMP3-端口电压
		100=  VDD经过内部电阻分压后的电压
		101=  BG
		11x=  BG
	Bit2  CMPxNV:  CMPO端口输出取反控制位
		1=  CMPOUT在CMPO端口取反输出
		0=  CMPOUT在CMPO端口正常输出
	Bit1  CMPxOUT:  CMP结果位
	Bit0  CMPxOEN:  CMPO端口输出使能位
		1=  使能CMPO端口输出CMPOUT
		0=  禁止CMPO端口输出CMPOUT
	*****************************************************/
	CMP1CON0 = 0B00111000;			//配置比较器1正端为VDD分压，负端为BG1.2V，禁止比较器输出
	
	CMP2CON0 = 0B00111001;			//配置比较器2正端为VDD分压，负端为BG1.2V，使能比较器输出
	/***************************************
	比较器控制寄存器 CMPxCON1(10H)
	Bit7  CMPxIM:  CMP中断触发边沿选择
		1=  CMP输出的下降沿触发中断
		0=  CMP输出的上升沿触发中断
	Bit6  ANx_EN:  模拟选择位，选择CMP+、CMPX-的模拟或数字功能
		1=  模拟口
		0=  数字口
	Bit5  RBIASx_H:  具体用法参考比较器框图
	Bit4  RBIASx_L:  具体用法参考比较器框图
	Bit3~Bit0  LVDSx<3:0>:  内部电阻分压比选择位
	****************************************************/
	
	CMP1CON1 = 0B10010111;			//	测试VDD电压低于3.6V中断，故为下降沿触发
									//Bit5~0对应的电压值可参考芯片说明书
	CMP2CON1 = 0B10000000;			//	测试VDD电压低于4.27V中断，故为下降沿触发
	
	INTCON = 0XC0;					//允许总中断及外设中断

	CMP1EN = 1;						//比较器使能
	CMP1IF =0;						//清比较器中断标志位
		
	CMP2EN = 1;						//比较器使能
	CMP2IF =0;						//清比较器中断标志位

									//要先使能比较器再打开中断允许
	PIE1 = 0X20;					//允许比较器1中断
	PIE2 = 0X20;					//允许比较器2中断
	while(1)
	{
		asm("clrwdt");
		
						
	}
}

/***********************************************
函数名称：CMP_Isr
函数功能：INT中断服务
入口参数：无
出口参数：无
备注：
************************************************/
void interrupt CMP_Isr()
{
	if(CMP1IF)
	{
		CMP1IF = 0;			//清中断标志
		
		PORTA ^= 0X80;
		
	}
	if(CMP2IF)
	{
		CMP2IF = 0;			//清中断标志
		PORTA ^= 0X40;
		
	}
}
