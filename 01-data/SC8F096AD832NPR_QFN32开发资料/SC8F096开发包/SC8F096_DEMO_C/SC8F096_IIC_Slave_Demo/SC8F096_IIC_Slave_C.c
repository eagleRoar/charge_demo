/**********************************************************

**********************************************************/

#include <sc.h>



volatile unsigned int   result,result1,result2;
volatile unsigned char IICReadData;
void DelayXms(unsigned char x);
void Init_System();


#define  SLAVE_ADRSS   0xa0

/***********************************************************
函数名称：DelayXms
函数功能：毫秒级非精准延时
入口参数：x - 延时时间
出口参数：
备    注：
***********************************************************/
void DelayXms(unsigned char x)
{
	unsigned char i,j;
	for(i=x;i>0;i--)
		for(j=153;j>0;j--);
}

/***********************************************************
main主函数
***********************************************************/



void main()
{
	Init_System();
	TRISA |=  0B00000011;  //RA0 RA1输入态，做IIC 引脚时为开漏，需要外接上拉电阻
	
	/********** IICCON ***********************************
	Bit7  IICWCOL:  写冲突检测位。
		主控模式:  
			1= 在IIC不满足开始发送数据的条件下，试图对IICBUF寄存器进行写操作。
			0= 未发生冲突。
		从动模式: 
			1= 正在发送前一个字时，又对IICBUF寄存器进行写操作（必须由软件清零）。
			0= 未发生冲突。
	Bit6  IICOV:  接收溢出指示位。(仅在从动接收模式下有限)
			1=  IICBUF寄存器仍保持前一数据时，又接收到一个新的字节。在发送模式下IICOV
				位可为任意值（该位必须由软件清零）。
			0=  没有溢出。
	Bit5  IICEN:  IIC使能位（必须正确配置这些引脚为输入）。
			1=  使能IIC并将SDA和SCL引脚配置为串行端口引脚。
			0=  禁止IIC并将这些引脚配置为I/O端口引脚。
	Bit4  IICCKP:  时钟极性选择位。
		在IIC从动模式下:  SCK释放控制。
			1 = 使能时钟。
			0 = 保持时钟线为低电平（时钟延长）（用于确保数据建立时间）。
		在IIC主控模式下:  在此模式下未使用。
	Bit3~Bit2  IICTOS[1:0]:  IIC从动模式超时选择
		00=  禁止IIC从动超时功能；
		01=  使能IIC从动超时功能，超时时间为16ms，超时后复位IIC模块；
		10=  使能IIC从动超时功能，超时时间为32ms，超时后复位IIC模块；
		11=  使能IIC从动超时功能，超时时间为64ms，超时后复位IIC模块；
	Bit1~Bit0  IICM<1:0>:  IIC模式选择位。
		00=  IIC主控模式，时钟=  FCPU / (IICADD+4)；
		01=  IIC从动模式，7位地址，不响应起始位和停止位中断；
		10=  IIC从动模式，7位地址，并允许起始位和停止位中断；
		11=  允许操作IICMSK寄存器
	*************************************************/
	IICCON =  0B00100001;  // IIC 使能  从机模式
	
    IICADD = 0xa0;          // 
	IICIE =1;
	PEIE =1;
    GIE =1;	


	while(1)
	{

	}
}



/***********************************************
函数名称：Init_System
函数功能：系统初始化
入口参数：无
出口参数：无
备注：
************************************************/
void Init_System()
{
	asm("nop");
	asm("clrwdt");
	INTCON = 0;					//系统初始化
	OSCCON = 0X70;				//配置振荡为8M,开 WDT
	OPTION_REG = 0;
	
    WPUA  = 0B00000000;			//初始化上拉
    WPUB  = 0B00001000;			
  
 
	TRISA = 0B00000000;			//初始化IO状态
	TRISB = 0B00001000;

	PORTA = 0B00000000;
	PORTB = 0B00000000;			//初始化输出

}

/***********************************************
函数名称：
函数功能：IIC中断服务
入口参数：无
出口参数：无
备注：
************************************************/
void interrupt IIC_Isr()
{
	
	if(IICIF==1)
	{
		IICIF =0;
	
		
		if(RW==1)   //发送数据
		{
			IICBUF = 0x55;
		}
		else
		{
			if(DA==0)  //地址匹配
			{
				IICBUF;
				
			}
			else
			{
				
			  IICReadData = IICBUF;  //接收数据
			}
		}
			
		
		
		IICCKP =1;
	
	}
}